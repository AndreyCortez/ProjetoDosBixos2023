#include <SPI.h>
#include <LoRa.h>
#include <string.h>

//////////////////////////////////////////////////////////////////////////////////////////////////////////////
/////////////////// Use esse espaço para declarar que pinos do arduino serão usados  /////////////////////////

#define MOTOR_ESQUERDO 3
#define MOTOR_DIREITO 5

#define IN1 1
#define IN2 2

#define IN3 4
#define IN4 6

#define ACELERADOR A0
#define VOLANTE A1

//////////////////////////////////////////////////////////////////////////////////////////////////////////////
//////////////////////////////////////////////////////////////////////////////////////////////////////////////

int saturar(int valor, int max, int min)
{
    if (valor > max)
    return max;
    if (valor < min)
    return min;
    return valor;
}


void setup()
{

    //////////////////////////////////////////////////////////////////////////////////////////////////////////////
    ///////////////////////// Use esse espaço para inicializar os pinos do Arduino ///////////////////////////////

    pinMode(MOTOR_ESQUERDO, OUTPUT);
    pinMode(MOTOR_DIREITO, OUTPUT);

    pinMode(IN1, OUTPUT);
    pinMode(IN2, OUTPUT);
    pinMode(IN3, OUTPUT);
    pinMode(IN4, OUTPUT);

    //////////////////////////////////////////////////////////////////////////////////////////////////////////////
    //////////////////////////////////////////////////////////////////////////////////////////////////////////////

    Serial.begin(9600);
    while (!Serial)
        ;

    Serial.println("LoRa Sender");

    if (!LoRa.begin(433E6))
    {
        Serial.println("Starting LoRa failed!");
        while (1)
            ;
    }
}

void loop()
{

    int potencia_bruto = 0;
    int direcao_bruto = 0;

    float potencia = 0.0;
    float direcao = 0.0;

    int motor_esquerdo_potencia = 0;
    int motor_direito_potencia = 0;

    int motor_esquerdo_in1 = 1;
    int motor_esquerdo_in2 = 0;

    int motor_direito_in3 = 1;
    int motor_direito_in4 = 0;

    //////////////////////////////////////////////////////////////////////////////////////////////////////////////
    ///////////////////////// Use esse espaço para realizar a leitura dos pinos //////////////////////////////////

    potencia_bruto =  analogRead(ACELERADOR);
    direcao_bruto = analogRead(VOLANTE);

    potencia = (float) potencia_bruto / 1023.0;
    direcao = ((float)direcao_bruto / 511.5) - 1;

    //////////////////////////////////////////////////////////////////////////////////////////////////////////////
    //////////////////////////////////////////////////////////////////////////////////////////////////////////////

    //////////////////////////////////////////////////////////////////////////////////////////////////////////////
    ///////////////////////// Use esse espaço para fazer os cálculos do diferencial //////////////////////////////

    float torque_adicionado;
    float diametro_da_roda = 2;
    float distancia_entre_eixos = 2;
    float pi = 3.1415;
    float range_volante = 24.5 * (pi / 180);

    torque_adicionado = diametro_da_roda * tan((direcao * range_volante)) / (2 * distancia_entre_eixos);
    motor_esquerdo_potencia = potencia_bruto * (1 - torque_adicionado);
    motor_direito_potencia = potencia_bruto * (1 + torque_adicionado);
    motor_esquerdo_potencia = saturar(motor_esquerdo_potencia, 255, 0);
    motor_direito_potencia = saturar(motor_direito_potencia, 255, 0);

    //////////////////////////////////////////////////////////////////////////////////////////////////////////////
    //////////////////////////////////////////////////////////////////////////////////////////////////////////////

    //////////////////////////////////////////////////////////////////////////////////////////////////////////////
    ////////////////////// Use esse espaço para ralizar a escrita nos pinos do arduino ///////////////////////////

    analogWrite(MOTOR_DIREITO, motor_direito_potencia);
    analogWrite(MOTOR_ESQUERDO, motor_esquerdo_potencia);

    //////////////////////////////////////////////////////////////////////////////////////////////////////////////
    //////////////////////////////////////////////////////////////////////////////////////////////////////////////

    char _data[30] = "";
    sprintf(_data, "%d %d %d %d %d %d ", motor_esquerdo_potencia, motor_esquerdo_in1, motor_esquerdo_in2,
            motor_direito_potencia, motor_direito_in3, motor_direito_in4);

    LoRa.beginPacket();
    LoRa.print(_data);
    LoRa.endPacket();
}
